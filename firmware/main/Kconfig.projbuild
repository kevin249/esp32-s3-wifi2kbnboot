## firmware/main/Kconfig.projbuild
```kconfig
menu "独立Wi-Fi虚拟启动盘"
config W2B_WIFI_STA
    bool "连接现有Wi-Fi；关闭则由ESP32提供热点"
    default n
config W2B_AP_SSID
    string "设备热点名称"
    default "ESP32-KVM"
config W2B_AP_PASSWORD
    string "设备热点密码，8～63字节"
    default "change-me-12345"
config W2B_WIFI_SSID
    string "Wi-Fi 名称"
    default "请配置WiFi"
config W2B_WIFI_PASSWORD
    string "Wi-Fi 密码"
    default ""
config W2B_TOKEN
    string "网页访问令牌，至少16个ASCII字符"
    default "change-this-token-before-use"
config W2B_CACHE_BLOCKS
    int "16KiB 缓存块数量；32块需要512KiB可用PSRAM"
    range 4 256
    default 8
config W2B_PREFETCH_BLOCKS
    int "连续读取的预读块数"
    range 0 4
    default 2
config W2B_SD_CLK
    int "SDMMC时钟GPIO"
    range 0 48
    default 14
config W2B_SD_CMD
    int "SDMMC命令GPIO"
    range 0 48
    default 15
config W2B_SD_D0
    int "SDMMC数据0 GPIO；仅使用1位模式"
    range 0 48
    default 2
config W2B_FILE_DISK_MIB
    int "首次创建FAT16文件盘的容量MiB"
    range 32 1024
    default 128
config W2B_UPLOAD_MIB
    int "单次网页上传上限MiB；大ISO建议分卷"
    range 1 1024
    default 1024
config W2B_BIOS_DISK_ONLY
    bool "BIOS兼容构建：仅单逻辑盘普通U盘，关闭USB光驱和键鼠"
    default n
config W2B_REFRESH_IDLE_MS
    int "刷新前最短读取空闲时间（毫秒）；不代表上层操作完成"
    range 1000 30000
    default 3000
config W2B_HID_RELEASE_MS
    int "键鼠没有新指令时自动释放的超时（毫秒）"
    range 200 10000
    default 1500
config W2B_PWR_GPIO
    int "主机PWR控制GPIO，-1表示禁用"
    range -1 48
    default -1
config W2B_RESET_GPIO
    int "主机RESET控制GPIO，-1表示禁用"
    range -1 48
    default -1
config W2B_POWER_ACTIVE_HIGH
    bool "主板按键驱动电路为高电平有效"
    default y
config W2B_POWER_OPEN_DRAIN
    bool "GPIO使用开漏输出；必须配合适当的外部上拉与驱动电路"
    default n
endmenu
```

## firmware/sdkconfig.defaults
```kconfig
CONFIG_IDF_TARGET="esp32s3"
CONFIG_ESPTOOLPY_FLASHSIZE_8MB=y
CONFIG_PARTITION_TABLE_SINGLE_APP_LARGE=y
CONFIG_FREERTOS_HZ=1000
CONFIG_ESP_MAIN_TASK_STACK_SIZE=6144
CONFIG_ESP_CONSOLE_UART_DEFAULT=y
CONFIG_COMPILER_OPTIMIZATION_PERF=y
CONFIG_FATFS_VOLUME_COUNT=2
CONFIG_FATFS_LFN_HEAP=y
CONFIG_FATFS_API_ENCODING_UTF_8=y
CONFIG_FATFS_FS_LOCK=16
CONFIG_HTTPD_MAX_REQ_HDR_LEN=2048
CONFIG_HTTPD_MAX_URI_LEN=768
CONFIG_LWIP_MAX_SOCKETS=12
```
